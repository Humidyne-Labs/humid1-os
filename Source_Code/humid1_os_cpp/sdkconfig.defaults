## Source_Code/humid1_os_cpp/sdkconfig.defaults
```kconfig
# =========================================================================
# Target Hardware: ESP32-S3-PICO-1-N8R8 (8MB Flash QIO, 8MB PSRAM Octal OPI)
# Target Board: Waveshare ESP32-S3-Touch-ePaper-1.54 V2
# =========================================================================

# Target Architecture & Clocking
CONFIG_IDF_TARGET="esp32s3"
CONFIG_ESP_DEFAULT_CPU_FREQ_MHZ_240=y
CONFIG_ESP_DEFAULT_CPU_FREQ_MHZ=240

# Compiler & Performance Optimization
CONFIG_COMPILER_OPTIMIZATION_PERF=y
CONFIG_LV_ATTRIBUTE_FAST_MEM_USE_IRAM=n
CONFIG_LV_DRAW_SW_DRAW_UNIT_CNT=1
CONFIG_LV_OS_FREERTOS=y

# Board Support Package (BSP) Feature Toggles
CONFIG_BSP_AUDIO_DEFAULT_VOLUME=0
CONFIG_BSP_ENABLE_THINGSBOARD=y

# Audio Codec (Everest ES8311 - Disable 9 Unused Codec Drivers)
CONFIG_CODEC_ES8311_SUPPORT=y
CONFIG_CODEC_ES7210_SUPPORT=n
CONFIG_CODEC_ES7243_SUPPORT=n
CONFIG_CODEC_ES7243E_SUPPORT=n
CONFIG_CODEC_ES8156_SUPPORT=n
CONFIG_CODEC_AW88298_SUPPORT=n
CONFIG_CODEC_ES8389_SUPPORT=n
CONFIG_CODEC_ES8374_SUPPORT=n
CONFIG_CODEC_ES8388_SUPPORT=n
CONFIG_CODEC_TAS5805M_SUPPORT=n

# =========================================================================
# LVGL v9 Graphics Engine (Debloated 1-Bit Monochrome SSD1681 Optimization)
# =========================================================================
CONFIG_LV_CONF_SKIP=y
CONFIG_LV_COLOR_DEPTH_1=y
CONFIG_LV_COLOR_DEPTH=1
CONFIG_LV_DRAW_SW_SUPPORT_I1=y
CONFIG_LV_DRAW_SW_I1_LUM_THRESHOLD=170
CONFIG_LV_DRAW_BUF_ALIGN=4
CONFIG_LV_DPI_DEF=188

# Memory Allocation & C Library Speedup
CONFIG_LV_USE_CLIB_MALLOC=y
CONFIG_LV_USE_CLIB_SPRINTF=y
CONFIG_LV_USE_CLIB_STRING=y

# Core Widgets Required for ePaper UI
CONFIG_LV_USE_QRCODE=y
CONFIG_LV_USE_LABEL=y
CONFIG_LV_USE_BUTTON=y
CONFIG_LV_USE_LINE=y
CONFIG_LV_USE_IMAGE=y
CONFIG_LV_USE_OBJ=y

# Fonts: Keep Only Montserrat 14, Disable Unused Bitmap & Fixed Fonts
CONFIG_LV_FONT_MONTSERRAT_8=n
CONFIG_LV_FONT_MONTSERRAT_10=n
CONFIG_LV_FONT_MONTSERRAT_12=n
CONFIG_LV_FONT_MONTSERRAT_14=y
CONFIG_LV_FONT_DEFAULT_MONTSERRAT_14=y
CONFIG_LV_FONT_MONTSERRAT_16=n
CONFIG_LV_FONT_MONTSERRAT_18=n
CONFIG_LV_FONT_MONTSERRAT_20=n
CONFIG_LV_FONT_MONTSERRAT_22=n
CONFIG_LV_FONT_MONTSERRAT_24=n
CONFIG_LV_FONT_MONTSERRAT_26=n
CONFIG_LV_FONT_MONTSERRAT_28=n
CONFIG_LV_FONT_MONTSERRAT_30=n
CONFIG_LV_FONT_MONTSERRAT_32=n
CONFIG_LV_FONT_MONTSERRAT_34=n
CONFIG_LV_FONT_MONTSERRAT_36=n
CONFIG_LV_FONT_MONTSERRAT_38=n
CONFIG_LV_FONT_MONTSERRAT_40=n
CONFIG_LV_FONT_MONTSERRAT_42=n
CONFIG_LV_FONT_MONTSERRAT_44=n
CONFIG_LV_FONT_MONTSERRAT_46=n
CONFIG_LV_FONT_MONTSERRAT_48=n
CONFIG_LV_FONT_UNSCII_8=n
CONFIG_LV_FONT_UNSCII_16=n

# Build: Disable LVGL Examples and Demos
CONFIG_LV_BUILD_EXAMPLES=n
CONFIG_LV_BUILD_DEMOS=n
CONFIG_LV_USE_DEMO_WIDGETS=n
CONFIG_LV_USE_DEMO_KEYPAD_AND_ENCODER=n
CONFIG_LV_USE_DEMO_BENCHMARK=n
CONFIG_LV_USE_DEMO_RENDER=n
CONFIG_LV_USE_DEMO_STRESS=n
CONFIG_LV_USE_DEMO_MUSIC=n
CONFIG_LV_USE_DEMO_FLEX_LAYOUT=n
CONFIG_LV_USE_DEMO_MULTILANG=n
CONFIG_LV_USE_DEMO_TRANSFORM=n
CONFIG_LV_USE_DEMO_SCROLL=n
CONFIG_LV_USE_DEMO_VECTOR_GRAPHIC=n

# Themes: Enable Mono / Simple, Disable Heavy Default Theme
CONFIG_LV_USE_THEME_DEFAULT=n
CONFIG_LV_USE_THEME_MONO=y
CONFIG_LV_USE_THEME_SIMPLE=y

# Layouts: Keep Flex, Disable Grid & Observers
CONFIG_LV_USE_FLEX=y
CONFIG_LV_USE_GRID=n
CONFIG_LV_USE_OBSERVER=n

# Debloat: Disable Unused LVGL Widgets
CONFIG_LV_USE_ANIMIMG=n
CONFIG_LV_USE_ARC=n
CONFIG_LV_USE_ARCLABEL=n
CONFIG_LV_USE_BAR=n
CONFIG_LV_USE_BUTTONMATRIX=n
CONFIG_LV_USE_CALENDAR=n
CONFIG_LV_USE_CANVAS=n
CONFIG_LV_USE_CHART=n
CONFIG_LV_USE_CHECKBOX=n
CONFIG_LV_USE_DROPDOWN=n
CONFIG_LV_USE_IMAGEBUTTON=n
CONFIG_LV_USE_KEYBOARD=n
CONFIG_LV_USE_LED=n
CONFIG_LV_USE_LIST=n
CONFIG_LV_USE_MENU=n
CONFIG_LV_USE_MSGBOX=n
CONFIG_LV_USE_ROLLER=n
CONFIG_LV_USE_SCALE=n
CONFIG_LV_USE_SLIDER=n
CONFIG_LV_USE_SPAN=n
CONFIG_LV_USE_SPINBOX=n
CONFIG_LV_USE_SPINNER=n
CONFIG_LV_USE_SWITCH=n
CONFIG_LV_USE_TEXTAREA=n
CONFIG_LV_USE_TABLE=n
CONFIG_LV_USE_TABVIEW=n
CONFIG_LV_USE_TILEVIEW=n
CONFIG_LV_USE_WIN=n

# Debloat: Disable Third-Party Decoders & Vector Engines
CONFIG_LV_USE_FREETYPE=n
CONFIG_LV_USE_TINY_TTF=n
CONFIG_LV_USE_FFMPEG=n
CONFIG_LV_USE_LODEPNG=n
CONFIG_LV_USE_LIBPNG=n
CONFIG_LV_USE_BMP=n
CONFIG_LV_USE_TJPGD=n
CONFIG_LV_USE_LIBJPEG_TURBO=n
CONFIG_LV_USE_GIF=n
CONFIG_LV_USE_BARCODE=n
CONFIG_LV_USE_VECTOR_GRAPHIC=n
CONFIG_LV_USE_SNAPSHOT=n
CONFIG_LV_USE_MONKEY=n
CONFIG_LV_USE_PROFILER=n
CONFIG_LV_USE_PERF_MONITOR=n
CONFIG_LV_USE_MEM_MONITOR=n

# Supported Color Formats
CONFIG_LV_DRAW_SW_SUPPORT_RGB565=y
CONFIG_LV_DRAW_SW_SUPPORT_ARGB8888=y
CONFIG_LV_DRAW_SW_SUPPORT_A8=y
CONFIG_LV_DRAW_SW_SUPPORT_RGB565_SWAPPED=n
CONFIG_LV_DRAW_SW_SUPPORT_RGB565A8=n
CONFIG_LV_DRAW_SW_SUPPORT_RGB888=n
CONFIG_LV_DRAW_SW_SUPPORT_XRGB8888=n
CONFIG_LV_DRAW_SW_SUPPORT_ARGB8888_PREMULTIPLIED=n
CONFIG_LV_DRAW_SW_SUPPORT_L8=n
CONFIG_LV_DRAW_SW_SUPPORT_AL88=n

# SPI Flash Configuration (8MB Quad SPI @ 80MHz)
CONFIG_ESPTOOLPY_FLASHSIZE_8MB=y
CONFIG_ESPTOOLPY_FLASHSIZE="8MB"
CONFIG_ESPTOOLPY_FLASHMODE_QIO=y
CONFIG_ESPTOOLPY_FLASHFREQ_80M=y

# PSRAM Configuration (8MB Octal SPI @ 80MHz)
CONFIG_SPIRAM=y
CONFIG_SPIRAM_MODE_OCT=y
CONFIG_SPIRAM_SPEED_80M=y
CONFIG_SPIRAM_FETCH_INSTRUCTIONS=y
CONFIG_SPIRAM_RODATA=y
CONFIG_SPIRAM_USE_MALLOC=y
CONFIG_SPIRAM_MALLOC_ALWAYSINTERNAL=4096

# Custom Dual-Slot OTA Partition Table
CONFIG_PARTITION_TABLE_CUSTOM=y
CONFIG_PARTITION_TABLE_CUSTOM_FILENAME="partitions.csv"
CONFIG_PARTITION_TABLE_FILENAME="partitions.csv"

# Bluetooth & NimBLE Provisioning (GATT Scheme for Web Dashboard & App)
CONFIG_BT_ENABLED=y
CONFIG_BT_NIMBLE_ENABLED=y
CONFIG_BT_NIMBLE_NVS_PERSIST=y
CONFIG_NETWORK_PROV_NETWORK_TYPE_WIFI=y
CONFIG_NETWORK_PROV_AUTOSTOP_TIMEOUT=60
CONFIG_NETWORK_PROV_BLE_SEC_CONN=y
CONFIG_ESP_PROTOCOMM_SUPPORT_SECURITY_VERSION_0=y
CONFIG_ESP_PROTOCOMM_SUPPORT_SECURITY_VERSION_1=y
CONFIG_ESP_PROTOCOMM_SUPPORT_SECURITY_VERSION_2=y

# TLS, Security & Certificate Bundle (for MQTTS & OTA)
CONFIG_MBEDTLS_CERTIFICATE_BUNDLE=y
CONFIG_MBEDTLS_CERTIFICATE_BUNDLE_DEFAULT_FULL=y
CONFIG_ESP_TLS_USING_MBEDTLS=y
CONFIG_ESP_HTTPS_OTA_DECRYPT_CB=n

# =========================================================================
# Dual-Core Task Affinity & Multi-Threading Orchestration
# =========================================================================
# Core 0: Dedicated Networking, Radio, TCP/IP, BLE, and MQTT Stack
# Core 1: Dedicated Display Engine, LVGL v9 Rendering, and Touch Input
CONFIG_FREERTOS_HZ=1000
CONFIG_FREERTOS_UNICORE=n
CONFIG_ESP_WIFI_TASK_PINNED_TO_CORE_0=y
CONFIG_BT_NIMBLE_PINNED_TO_CORE_0=y
CONFIG_LWIP_TCPIP_TASK_AFFINITY_CPU0=y
CONFIG_ESP_MAIN_TASK_AFFINITY_CPU0=y

# FreeRTOS Task Monitoring & Diagnostics
CONFIG_FREERTOS_USE_TRACE_FACILITY=y
CONFIG_FREERTOS_USE_STATS_FORMATTING_FUNCTIONS=y
CONFIG_FREERTOS_VTASKLIST_INCLUDE_COREID=y
CONFIG_FREERTOS_CHECK_STACKOVERFLOW_CANARY=y
```

## Source_Code/humid1_os_cpp/sdkconfig.defaults.dev
```kconfig
# Profile: dev (Development & Debugging)
CONFIG_COMPILER_OPTIMIZATION_DEFAULT=y
CONFIG_LOG_DEFAULT_LEVEL_INFO=y
CONFIG_BOOTLOADER_LOG_LEVEL_INFO=y

# Active LVGL Logging
CONFIG_LV_USE_LOG=y
CONFIG_LV_LOG_LEVEL_INFO=y
CONFIG_LV_LOG_PRINTF=y

# FreeRTOS Task Monitoring & Canary Safety
CONFIG_FREERTOS_USE_TRACE_FACILITY=y
CONFIG_FREERTOS_USE_STATS_FORMATTING_FUNCTIONS=y
CONFIG_FREERTOS_VTASKLIST_INCLUDE_COREID=y
CONFIG_FREERTOS_CHECK_STACKOVERFLOW_CANARY=y
```

## Source_Code/stage/humid1-os/sdkconfig.defaults
```kconfig
# Target ESP32-S3 PICO-1-N8R8 Configuration (8MB Flash QSPI, 8MB PSRAM Octal)
CONFIG_IDF_TARGET="esp32s3"

# Flash settings (8MB)
CONFIG_ESPTOOLPY_FLASHSIZE_8MB=y
CONFIG_ESPTOOLPY_FLASHSIZE="8MB"
CONFIG_ESPTOOLPY_FLASHMODE_QIO=y
CONFIG_ESPTOOLPY_FLASHFREQ_80M=y

# PSRAM settings (8MB Octal SPI)
CONFIG_SPIRAM=y
CONFIG_SPIRAM_MODE_OCT=y
CONFIG_SPIRAM_SPEED_80M=y
CONFIG_SPIRAM_USE_MALLOC=y

# Custom Partition Table
CONFIG_PARTITION_TABLE_CUSTOM=y
CONFIG_PARTITION_TABLE_CUSTOM_FILENAME="partitions.csv"
CONFIG_PARTITION_TABLE_FILENAME="partitions.csv"

# FreeRTOS Clock Rate
CONFIG_FREERTOS_HZ=1000
```
